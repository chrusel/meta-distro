## conf/distro/chruselpoky.conf
```bitbake
# Distro Layer configuration

# include default poky distro
include conf/distro/poky.conf

# overwrite default poky distro
DISTRO = "chruselpoky"
DISTRO_NAME = "Yocto based Linux Distribution called ChruselPoky"

# Be in sync with upstream poky and sdk regarding version numbering
#DISTRO_VERSION
#DISTRO_CODENAME
#SDK_VERSION

SDK_VENDOR = "-${DISTRO}sdk"

MAINTAINER = "github@herzig.info"
TARGET_VENDOR = "-${DISTRO}"

# Override these in poky based distros
#PREFERRED_VERSION_adp-linux ?= "4.19%"

# Use systemd as init manager
DISTRO_FEATURES_append = " systemd"
DISTRO_FEATURES_BACKFILL_CONSIDERED += "sysvinit"
VIRTUAL-RUNTIME_init_manager = "systemd"
VIRTUAL-RUNTIME_initscripts = "systemd-compat-units"

# Define ImageFS types:
IMAGE_FSTYPES = "wic wic.bmap"
```
